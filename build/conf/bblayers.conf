## build/conf/bblayers.conf
```bitbake
# POKY_BBLAYERS_CONF_VERSION is increased each time build/conf/bblayers.conf
# changes incompatibly
POKY_BBLAYERS_CONF_VERSION = "2"

BBPATH = "${TOPDIR}"
BBFILES ?= ""

BBLAYERS ?= " \
  /workdir/oe-core/meta \
  /workdir/oe-core/meta-poky \
  /workdir/oe-core/meta-yocto-bsp \
  /workdir/meta-raspberrypi \
  /workdir/meta-custom \
  "
```
